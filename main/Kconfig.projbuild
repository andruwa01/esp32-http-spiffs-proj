## main/Kconfig.projbuild
```kconfig
menu "esp32s3 spiffs conf for storage satellite data"
    config PC_IP_WIFI
        string "pc IPV4 address in wifi network"
        default "172.20.10.11"
        help
            PC IPV4 Adress in wi-fi network.
    
    config BOARD_IP_WIFI
        string "board IPV4 address in wifi network"
        default "172.20.10.9"
    
    config PC_PORT
        int "Pc Port"
        range 0 65535
        default 3333
        help
            The remote (pc) port
    
    config BOARD_PORT
        int "Board Port"
        range 0 65535
        default 4444
        help
            local (board) port

    config LED_GPIO
        int "LED GPIO number"
        range 0 48
        default 2
        help
            LED GPIO

    config ESP_WIFI_SSID
        string "WiFi SSID"
        default "tempssid"
        help
            SSID (network name) for the example to connect to.

    config ESP_WIFI_PASSWORD
        string "WiFi Password"
        default "temppassword"
        help
            WiFi password (WPA or WPA2) for the example to use.
            
    config ESP_MAXIMUM_RETRY
        int "Maximum retry"
        default 5
        help
            Set the Maximum retry to avoid station reconnecting to the AP unlimited when the AP is really inexisted
endmenu
```

## sdkconfig.defaults_udp
```kconfig
CONFIG_IDF_TARGET="esp32s3"
CONFIG_BOOTLOADER_LOG_LEVEL_NONE=y
CONFIG_ESPTOOLPY_FLASHSIZE_16MB=y
CONFIG_PARTITION_TABLE_CUSTOM=y
CONFIG_ESP_WIFI_SSID="dron_ap"
CONFIG_ESP_WIFI_PASSWORD="dron1542"
CONFIG_ESP_MAXIMUM_RETRY=1000
CONFIG_ESP_MAIN_TASK_STACK_SIZE=4096
CONFIG_ESP_CONSOLE_USB_SERIAL_JTAG=y
CONFIG_ESP_TIMER_TASK_STACK_SIZE=10512
CONFIG_SPIFFS_OBJ_NAME_LEN=128
```
